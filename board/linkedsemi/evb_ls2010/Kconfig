## board/linkedsemi/evb_ls2010/Kconfig
```kconfig
if TARGET_EVB_LS2010

config SYS_BOARD
    default "evb_ls2010"

config SYS_VENDOR
    default "linkedsemi"

config SYS_CONFIG_NAME
    default "evb_ls2010"

config SYS_CPU
    default "generic"

config BOARD_SPECIFIC_OPTIONS # dummy
	def_bool y
	select GENERIC_RISCV
    imply SMP
endif
```

## board/linkedsemi/lsbmc_evk/Kconfig
```kconfig
if TARGET_LSBMC_EVK

config SYS_BOARD
    default "lsbmc_evk"

config SYS_VENDOR
    default "linkedsemi"

config SYS_CONFIG_NAME
    default "lsbmc_evk"

config SYS_CPU
    default "generic"

config BOARD_SPECIFIC_OPTIONS # dummy
	def_bool y
	select GENERIC_RISCV
    imply SMP
endif
```

## configs/evb_ls2010_defconfig
```kconfig
CONFIG_RISCV=y
CONFIG_ARCH_RV64I=y
CONFIG_RISCV_SMODE=y
CONFIG_TARGET_EVB_LS2010=y
CONFIG_DEFAULT_DEVICE_TREE="evb_ls2010"
CONFIG_TEXT_BASE=0xc0400000
CONFIG_SYS_LOAD_ADDR=0xc0400000
CONFIG_HAS_CUSTOM_SYS_INIT_SP_ADDR=y
CONFIG_CUSTOM_SYS_INIT_SP_ADDR=0xc0480000
CONFIG_OF_BOARD=y
CONFIG_SYS_NS16550=y
CONFIG_DEBUG_UART=y
CONFIG_DEBUG_SBI_CONSOLE=y
CONFIG_BOOTDELAY=2
CONFIG_CMD_SBI=y
CONFIG_CMD_FDT=y
CONFIG_SUPPORT_RAW_INITRD=y
```

## configs/lsbmc_evk_defconfig
```kconfig
CONFIG_RISCV=y
CONFIG_ARCH_RV64I=y
CONFIG_RISCV_SMODE=y
CONFIG_TARGET_LSBMC_EVK=y
CONFIG_SYS_LOAD_ADDR=0x40100000
CONFIG_TEXT_BASE=0x40100000
CONFIG_SYS_NS16550=y
CONFIG_DEFAULT_DEVICE_TREE="lsbmc_evk"
```
